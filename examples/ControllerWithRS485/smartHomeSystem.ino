//------------------------------------------------------------------------------------------------------------------------------------------------------------------------
// ВСЯКИЕ ГЛОБАЛЬНЫЕ НАСТРОЙКИ ЯДРА - В ФАЙЛЕ src/config.h !!!
//------------------------------------------------------------------------------------------------------------------------------------------------------------------------
// настройки прошивки
//------------------------------------------------------------------------------------------------------------------------------------------------------------------------

#define RS485_SERIAL Serial1 // какой Serial использовать для RS-485 ?
#define SERIAL_SPEED 57600 // скорость работ всех задействованных Serial

//------------------------------------------------------------------------------------------------------------------------------------------------------------------------
#include "src/core.h" // подключаем ядро
#include "src/storage/eeprom.h" // будем использовать встроенную память EEPROM
#include "src/transport/rs485.h" // будем использовать RS-485 как транспорт
#include "src/utils/button.h" // подключаем поддержку кнопки с антидребезгом
#include "src/utils/trigger.h" // подключаем поддержку триггера (смена состояния через определённые промежутки времени)

//------------------------------------------------------------------------------------------------------------------------------------------------------------------------
#include "src/controller/controller.h" // будем работать, как контроллер
#include "src/controller/streamlistener.h" // подключаем слушатель команд из потока

//------------------------------------------------------------------------------------------------------------------------------------------------------------------------
// наши переменные
//------------------------------------------------------------------------------------------------------------------------------------------------------------------------

//------------------------------------------------------------------------------------------------------------------------------------------------------------------------
// транспорт
//------------------------------------------------------------------------------------------------------------------------------------------------------------------------
RS485 rs485(RS485_SERIAL, 4, 20); // работаем по RS-485 через Serial, пин переключения приема-передачи - 4, 20 миллисекунд на таймаут чтения входящих данных

//------------------------------------------------------------------------------------------------------------------------------------------------------------------------
// хранилище
//------------------------------------------------------------------------------------------------------------------------------------------------------------------------
Storage storage; // хранилище данных, где будет хранитьcя всякую служебную информацию (его использование обязательно!)

//------------------------------------------------------------------------------------------------------------------------------------------------------------------------
// кнопка регистрации и светодиод регистрации
//------------------------------------------------------------------------------------------------------------------------------------------------------------------------
button regBtn; // кнопка, которую мы будем использовать для регистрации в системе
const uint8_t regBtnPin = 12; // номер пина для кнопки регистрации
const uint8_t ledPin = 13; // номер пина для светодиода сигнализации процесса регистрации
trigger regTrigger; // триггер, который мы будем использовать для моргания светодиода при процессе регистрации

//------------------------------------------------------------------------------------------------------------------------------------------------------------------------
// сам контроллер
//------------------------------------------------------------------------------------------------------------------------------------------------------------------------  
SmartController controller(1234ul,"Теплица",storage); // идентификатор контроллера, имя контроллера, хранилище
StreamListener controllerCommands(Serial); // обработчик команд из Serial
  

//------------------------------------------------------------------------------------------------------------------------------------------------------------------------
void registration(bool result) // событие "результат регистрации"
{
  
  // останавливаем триггер мигающего светодиода
  regTrigger.stop();
  
  if(result)
  {
    DBGLN(F("REGISTRATION DONE!"));
    // гасим светодиод, сигнализирующий о процессе успешного завершения регистрации
    Pin::write(ledPin,LOW);
  }
  else
  {
    DBGLN(F("REGISTRATION ERROR!!!"));
    // зажигаем светодиод, сигнализируя о неуспешности регистрации
    Pin::write(ledPin,HIGH);
  }

  /*
   Поведение светодиода: 

    1. Модуль: если не зарегистрирован - горит. В процессе регистрации - мигает. Если регистрация успешна - гаснет и не горит;
    2. Контроллер: не горит. В процессе регистрации - мигает. Если регистрация неуспешна - горит.

   */
}
//------------------------------------------------------------------------------------------------------------------------------------------------------------------------
void setup()
{

  // если мы работаем как контроллер - поднимаем Serial, через него контроллер сможет принимать команды и выдавать на них ответы
  Serial.begin(SERIAL_SPEED);

  
  // если дебаг-режим включен - поднимает дебаг-сериал
  #ifdef _DEBUG
    DEBUG_SERIAL.begin(SERIAL_SPEED);
  #endif
  
  // поднимаем нужный Serial, поскольку мы используем RS-485 как транспорт
  RS485_SERIAL.begin(SERIAL_SPEED);

  // инициализируем хранилище
  storage.init(100); // с адреса 100 будем хранить служебные данные модуля или контроллера

  regBtn.begin(regBtnPin,true); // кнопка регистрации на пине regBtnPin, с подтяжкой к питанию, срабатывает по низкому уровню
  Pin::mode(ledPin,OUTPUT); // будем использовать светодиод на пине ledPin как сигнализатор процесса регистрации
  
  Pin::write(ledPin,LOW); // по умолчанию - светодиод регистрации погашен, что означает - контроллер не находится в режиме регистрации модуля
  
  // добавляем транспорты для контроллера  
  controller.addTransport(rs485); // поддерживаем RS-485

  // говорим контроллеру, чтобы он слушал команды из Serial
  controller.addStreamListener(controllerCommands);
  
  controller.begin(); // запускаем контроллер
  
  //TODO: ВАША ЛОГИКА ЗДЕСЬ !!!

}
//------------------------------------------------------------------------------------------------------------------------------------------------------------------------
void loop()
{

  regBtn.update(); // обновляем кнопку регистрации

  // проверяем триггер моргающего светодиода регистрации на срабатывание
  if(regTrigger.triggered())
  {
    // триггер сработал, меняем состояние светодиода на противоположное
    Pin::write(ledPin,!Pin::read(ledPin));
  }

  // если кнопка регистрации зажата и удерживается - начинаем процесс регистрации
  if(regBtn.isRetention())
  {   
    // начинаем моргать светодиодом
    regTrigger.start(500); // триггер будет срабатывать каждые 500 миллисекунд
    controller.startRegistration(10000ul); // начинаем регистрацию с таймаутом в 10 секунд
  }
  
  controller.update(); // обновляем контроллер 
  
  
  //TODO: ВАША ЛОГИКА ЗДЕСЬ !!!
  
}
//------------------------------------------------------------------------------------------------------------------------------------------------------------------------
void yield()
{

  // поскольку работа ядра - асинхронная, мы должны обязательно обновлять контроллер в функции yield, чтобы не потерять входящих данных
  controller.update();
  
}
//------------------------------------------------------------------------------------------------------------------------------------------------------------------------

